## firmware/main/Kconfig.projbuild
```kconfig
menu "Dashboard Wi-Fi"
    config WIFI_SSID
        string "Wi-Fi SSID"
        default "myssid"
    config WIFI_PASSWORD
        string "Wi-Fi password"
        default "mypassword"
    config LED_GPIO
        int "Onboard RGB LED GPIO"
        default 48
        help
            48 on most ESP32-S3-DevKitC-1, 38 on DevKitC-1 v1.1. Check the silkscreen near the LED.
endmenu
```

## firmware/sdkconfig.defaults
```kconfig
CONFIG_IDF_TARGET="esp32s3"
CONFIG_HTTPD_WS_SUPPORT=y
CONFIG_ESP_SYSTEM_EVENT_TASK_STACK_SIZE=4096
CONFIG_ESPTOOLPY_FLASHSIZE_16MB=y
CONFIG_PARTITION_TABLE_SINGLE_APP_LARGE=y
```
